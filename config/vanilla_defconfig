## config/vanilla_defconfig
```kconfig
CONFIG_NET_SCH_DEFAULT=y
CONFIG_DEFAULT_FQ=y

CONFIG_NET_SCH_CAKE=y

CONFIG_NETFILTER_XT_TARGET_HL=y
CONFIG_IP_NF_TARGET_TTL=y
CONFIG_IP6_NF_TARGET_HL=y

CONFIG_TCP_CONG_ADVANCED=y
CONFIG_TCP_CONG_CUBIC=y
CONFIG_TCP_CONG_BBR=y
CONFIG_TCP_CONG_WESTWOOD=y
CONFIG_TCP_CONG_HTCP=y
CONFIG_TCP_CONG_VEGAS=y
# CONFIG_TCP_CONG_BIC is not set
CONFIG_DEFAULT_BBR=y

CONFIG_CRYPTO_LZ4HC=y

CONFIG_SCHED_BORE=y
CONFIG_NTSYNC=y
CONFIG_CPU_FREQ_GOV_REFLEX=y
CONFIG_ONYX_BALANCE=y
CONFIG_MQ_IOSCHED_ADIOS=y
# CONFIG_MQ_IOSCHED_DEFAULT_ADIOS is not set
CONFIG_KCOMPRESSD=y
```
